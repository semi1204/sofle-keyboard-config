## modules/profile-modifiers/Kconfig
```kconfig
config ZMK_BEHAVIOR_PROFILE_MODIFIER
	bool
	default y
	depends on DT_HAS_ZMK_BEHAVIOR_PROFILE_MODIFIER_ENABLED
```

## modules/profile-modifiers/dts/bindings/behaviors/zmk,behavior-profile-modifier.yaml
```yaml
# SPDX-License-Identifier: MIT

description: |
  Select exactly two bindings for BLE profiles, preserving the pressed binding through release.
  Binding 0 is the default; binding 1 is selected for the configured Windows profile.
compatible: "zmk,behavior-profile-modifier"

include: zero_param.yaml

properties:
  bindings:
    type: phandle-array
    required: true
  windows-profile:
    type: int
    required: true
```

## modules/rate-scroll/Kconfig
```kconfig
config ZMK_BEHAVIOR_RATE_SCROLL
	bool
	default y
	depends on DT_HAS_ZMK_BEHAVIOR_RATE_SCROLL_ENABLED
```

## modules/rate-scroll/dts/bindings/behaviors/zmk,behavior-rate-scroll.yaml
```yaml
# SPDX-License-Identifier: MIT

description: Rate-aware vertical scroll pulse for rotary sensor bindings
compatible: "zmk,behavior-rate-scroll"

include: one_param.yaml

properties:
  scroll-behavior:
    type: phandle
    required: true
  pulse-ms:
    type: int
    required: true
```
